## sdkconfig.defaults
```kconfig
CONFIG_ESPTOOLPY_FLASHFREQ="80m"
CONFIG_ESPTOOLPY_FLASHSIZE="4MB"
CONFIG_ESPTOOLPY_HEADER_FLASHSIZE_UPDATE=y
CONFIG_ESPTOOLPY_BEFORE_NORESET=y
CONFIG_ESPTOOLPY_AFTER_NORESET=y
CONFIG_FREERTOS_TASK_FUNCTION_WRAPPER=n
CONFIG_LOG_DYNAMIC_LEVEL_CONTROL=n
CONFIG_ARDUHAL_LOG_DEFAULT_LEVEL_DEBUG=y
CONFIG_ESP_MAIN_TASK_STACK_SIZE=7680
CONFIG_ESP_TASK_WDT_INIT=n
#CONFIG_ESP_DEFAULT_CPU_FREQ_MHZ_240=y
```
